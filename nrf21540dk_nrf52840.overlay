&i2c1 {
    status = "okay";
    pinctrl-0 = <&i2c1_default>;
    pinctrl-1 = <&i2c1_sleep>;
    pinctrl-names = "default", "sleep";

    mysensor: mysensor@44 {
        compatible = "i2c-device";
        status = "okay";
        reg = <0x44>;  
        label = "mysensor";
    };
};

